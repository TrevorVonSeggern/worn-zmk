## boards/shields/worn/Kconfig.shield
```kconfig
config SHIELD_WORN_LEFT
    def_bool $(shields_list_contains,worn_left)

config SHIELD_WORN_RIGHT
    def_bool $(shields_list_contains,worn_right)
```

## config/west.yml
```yaml
manifest:
  remotes:
    - name: zmkfirmware
      url-base: https://github.com/zmkfirmware
  projects:
    - name: zmk
      remote: zmkfirmware
      revision: main
      import: app/west.yml
    - name: zmk-keyboard-torne
      url: https://github.com/TrevorVonSeggern/zmk-keyboard-torne
      revision: main
      import: west.yml
  self:
    path: config
```
